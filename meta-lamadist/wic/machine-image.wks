## meta-lamadist/wic/machine-image.wks
```
# vi:ft=kickstart
# SPDX-License-Identifier: Apache-2.0

part fsbl1 --source rawcopy --sourceparams="file=u-boot-spl.stm32" --part-name "fsbl1" --ondisk mmcblk --align 1 --size 256k
part fsbl2 --source rawcopy --sourceparams="file=u-boot-spl.stm32" --part-name "fsbl2" --ondisk mmcblk --align 1 --size 256k
part ssbl --source rawcopy --sourceparams="file=u-boot.itb" --part-name "ssbl" --ondisk mmcblk --align 1 --size 2M
part / --source rootfs --ondisk mmcblk0 --fstype=ext4 --label root_A --part-name "rootfs_A" --align 4096 --use-uuid --active
part /rootfsB --source rootfs --ondisk mmcblk0 --fstype=ext4 --label root_B --part-name "rootfs_B" --align 4096 --use-uuid

bootloader --ptable gpt

# short-description: Create an EFI disk image with grub-efi
# long-description: Creates a partitioned EFI disk image that the user
# can directly dd to boot media. The selected bootloader is grub-efi.
# It also includes intel-microcode as an initrd for early update support.

part /boot --source bootimg-efi --sourceparams="loader=grub-efi,initrd=microcode.cpio" --ondisk sda --label msdos --active --align 1024 --use-uuid

part / --source rootfs --ondisk sda --fstype=ext4 --label root_A --part-name rootfs_A --align 1024 --use-uuid
part / --source rootfs --ondisk sda --fstype=ext4 --label root_B --part-name rootfs_B --align 1024 --use-uuid

part swap --ondisk sda --size 44 --label swap1 --fstype=swap --use-uuid

bootloader --ptable gpt --timeout=5 --append=" rootfstype=ext4 "
```
